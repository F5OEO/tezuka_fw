## package/maiasdr-fw/Config.in
```kconfig
config BR2_PACKAGE_MAIASDR_FW
	bool "maiasdr_fw"
	select BR2_PACKAGE_MAIA_KMOD
	select BR2_PACKAGE_MAIA_HTTPD
	select BR2_PACKAGE_MAIA_WASM
	select BR2_PACKAGE_TEZUKA_COMMON_TOOLS
	select BR2_PACKAGE_OPENSSL
	select BR2_PACKAGE_LIBOPENSSL_BIN
	help
	  MaiaSDR Firmware


	
	
```

## package/nano_fpga/Config.in
```kconfig
config BR2_PACKAGE_NANO_FPGA
	bool "Nano_fpga"
	help
	  NanoMaia-iio default sytem_top.bit
```

## package/nng/Config.in
```kconfig
config BR2_PACKAGE_NNG
	bool "nng"
	select BR2_PACKAGE_VOLK
	
	help
	  Nano Message NNG
	  github (release)

	  

	  
```

## package/pluto-fpga/Config.in
```kconfig
config BR2_PACKAGE_PLUTO_FPGA
	bool "FPGA Synthesis of pluto system_top.bit"
	help
	  FPGA Synthesis of pluto system_top.bit
```

## package/pluto-system-top-bit/Config.in
```kconfig
config BR2_PACKAGE_PLUTO_SYSTEM_TOP_BIT
	bool "pluto default system_top.bit"
	help
	  PlutoSDR default sytem_top.bit
```

## package/pluto_stream/Config.in
```kconfig
config BR2_PACKAGE_PLUTO_STREAM
	bool "pluto-stream"
	depends on BR2_TOOLCHAIN_HAS_THREADS
	depends on BR2_ARM_CPU_HAS_NEON
	select BR2_PACKAGE_LIBIIO
	select BR2_PACKAGE_MOSQUITTO
	help
	  PlutoSDR DVB-S2 streaming and MQTT control applications.

	  Builds two binaries:
	    - pluto_mqtt_ctrl  (MQTT-based device control)
	    - pluto_stream     (DVB-S2 TX/RX streaming)

	  Requires libgse, Ne10 and civetweb at runtime.

	  https://github.com/YOUR_USER/pluto-stream
```

## package/plutomaia-iio-system-top-bit/Config.in
```kconfig
config BR2_PACKAGE_PLUTOMAIA_IIO_SYSTEM_TOP_BIT
	bool "plutomaia-iiosystem_top.bit"
	help
	  PlutoMaia-iio default sytem_top.bit
```

## package/plutomaia-system-top-bit/Config.in
```kconfig
config BR2_PACKAGE_PLUTOMAIA_SYSTEM_TOP_BIT
	bool "maia system_top.bit"
	help
	  PlutoSDR maiasdr sytem_top.bit
```

## package/plutoplusmaia-iio-system-top-bit/Config.in
```kconfig
config BR2_PACKAGE_PLUTOPLUSMAIA_IIO_SYSTEM_TOP_BIT
	bool "plutoplusmaia-iiosystem-top.bit"
	help
	  PlutoplusMaia-iio default sytem_top.bit
```

## package/rust-wasm/Config.in
```kconfig
config BR2_PACKAGE_RUST_WASM
	bool "rust-wasm (pre-built)"
    depends on BR2_PACKAGE_HOST_RUSTC_TARGET_ARCH_SUPPORTS
	select BR2_PACKAGE_HOST_RUSTC
	help
	   Rust standard library for the wasm.
```

## package/rxtools/Config.in
```kconfig
config BR2_PACKAGE_RXTOOLS
        bool "rxtools"
        select BR2_PACKAGE_SOAPYSDR
        depends on BR2_TOOLCHAIN_HAS_THREADS
             help
          rx_fm, rx_power, and rx_sdr tools for receiving data from SDRs, on rtl_fm, rtl_power, and rtl_sdr from librtlsdr, but using the SoapySDR vneutral SDR support library instead, intended to support a wider range of s than RTL-SDR

          https://github.com/rxseger/rx_tools
comment "rxtools needs a toolchain w/ threads"
        depends on !BR2_TOOLCHAIN_HAS_THREADS
```

## package/satdump/Config.in
```kconfig
config BR2_PACKAGE_SATDUMP
	bool "satdump"
	select BR2_PACKAGE_VOLK
	select BR2_PACKAGE_NANOMSG
	help
	  Satdump
	  github (release)

	  

	  
```

## package/sdonly/Config.in
```kconfig
config BR2_PACKAGE_SDONLY
	bool "SD Environment"
	#select BR2_PACKAGE_PYTHON_PYBIND
	select BR2_PACKAGE_GNURADIO_PYTHON
	select BR2_PACKAGE_GNURADIO
	select BR2_PACKAGE_PYTHON3
	select BR2_PACKAGE_GNURADIO_DIGITAL
	select BR2_PACKAGE_GNURADIO_IIO
	select BR2_PACKAGE_GNURADIO_CHANNELS
	select BR2_PACKAGE_GNURADIO_BLOCKS
	select BR2_PACKAGE_GNURADIO_ANALOG
	select BR2_PACKAGE_GNURADIO_AUDIO
	select BR2_PACKAGE_GNURADIO_FFT
	select BR2_PACKAGE_GNURADIO_UTILS
	select BR2_PACKAGE_GNURADIO_DIGITAL
	select BR2_PACKAGE_GNURADIO_DTV
	select BR2_PACKAGE_GNURADIO_FEC
	select BR2_PACKAGE_GNURADIO_NETWORK
	select BR2_PACKAGE_GNURADIO_ZEROMQ
	select BR2_PACKAGE_GR_SATELLITE
	select BR2_PACKAGE_GR_PDU
	#select BR2_PACKAGE_GR_DVBS2RX
	select BR2_PACKAGE_SOAPYSDR
	select BR2_PACKAGE_SOAPYPLUTOSDR
	#select BR2_PACKAGE_NODEJS
	#select BR2_PACKAGE_NODEJS_NPM
	
	help
	  "PlutoPlus SD Environment"
```

## package/sdr_usb_gadget/Config.in
```kconfig
config BR2_PACKAGE_SDR_USB_GADGET
        bool "sdr_usb_gadget"
        select BR2_PACKAGE_LIBIIO
        select BR2_PACKAGE_LIBAIO
        help
          Low latency SDR streaming gadget. Transferring IIO buffer
          objects via USB BULK transfers as fast as possible.
```

## package/signalsdrpro_fpga/Config.in
```kconfig
config BR2_PACKAGE_SIGNALSDRPRO_FPGA
	bool "signalsdrpro_fpga"
	help
	  PlutoplusMaia-iio default sytem_top.bit
```

## package/soapyplutosdr/Config.in
```kconfig
config BR2_PACKAGE_SOAPYPLUTOSDR
	bool "soapyplutosdr"
	depends on BR2_TOOLCHAIN_HAS_THREADS
	select BR2_PACKAGE_LIBIIO
	select BR2_PACKAGE_LIBAD9361_IIO
	select BR2_PACKAGE_SOAPYPLUTOSDR
	help
	  Soapy SDR plugin for PlutoSDR-Tezuka
	  https://github.com/pothosware/SoapyPlutoSDR
```

## package/soapysdr/Config.in
```kconfig
config BR2_PACKAGE_SOAPYSDR
	bool "soapysdr"
	help
	  Vendor and platform neutral SDR support library
	  github (release)

	  https://github.com/pothosware/SoapySDR.git

	  
```

## package/srt/Config.in
```kconfig
config BR2_PACKAGE_SRT
	bool "srt-master"
	help
	  transport protocol for ultra low (sub-second) latency live
	  github (release)

	  https://github.com/Haivision/srt

	  
```

## package/tezuka_tools/Config.in
```kconfig
config BR2_PACKAGE_TEZUKA_COMMON_TOOLS
	bool "Common tools for tezuka"
	select BR2_PACKAGE_TEZUKA_COMMON_TOOLS_MINI
	select BR2_PACKAGE_SSHPASS
	select BR2_PACKAGE_LIBCURL
	select BR2_PACKAGE_LIBCURL_CURL
	#AUDIO
    select BR2_PACKAGE_ALSA_UTILS
	select BR2_PACKAGE_ALSA_UTILS_APLAY
	#WIFI
	select BR2_PACKAGE_HOSTAPD
	select BR2_PACKAGE_WIRELESS_REGDB
	select BR2_PACKAGE_LINUX_FIRMWARE_ATHEROS_9271
	#USB ETHERNET
	select BR2_PACKAGE_LINUX_FIRMWARE_RTL_815X
	#kalibrate
	select BR2_PACKAGE_KALIBRATE 	
#Bluetooth alsa	
	#select BR2_PACKAGE_BLUEZ_ALSA
	#select BR2_PACKAGE_LSUIO
#Console
select BR2_PACKAGE_BUSYBOX_SHOW_OTHERS
select BR2_PACKAGE_READLINE
select BR2_PACKAGE_BASH	
#gps
select  BR2_PACKAGE_GPSD
select BR2_PACKAGE_GPSD_UBX
#DATV

#select BR2_PACKAGE_JANSSON
#select BR2_PACKAGE_FFTW 
#select BR2_PACKAGE_NE10

#select BR2_PACKAGE_SRT
#select BR2_PACKAGE_SDONLY
	help
	  "Tezuka common tools"
```

## package/wasm-pack/Config.in
```kconfig
config BR2_PACKAGE_WASM_PACK
	bool "wasm_pack"
	depends on BR2_PACKAGE_HOST_RUSTC_TARGET_ARCH_SUPPORTS
	select BR2_PACKAGE_RUST_WASM
	select BR2_PACKAGE_HOST_RUSTC
	help
	  WASM_PACK utility
```
