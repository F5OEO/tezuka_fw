## board/tezuka/opensdrlab7010mini/plutomaia.its
```
/*
 * U-Boot uImage source file with multiple kernels, ramdisks and FDT blobs
 * This example makes use of the 'loadables' field
 */

/*
 * fdt get addr foo /images/fdt@1 data
 */

/dts-v1/;

/ {
	description = "Configuration to load fpga before Kernel";
	magic = "ITB PlutoSDR (ADALM-PLUTO)";
	#address-cells = <1>;
	images {

		fdt@1 {
			description = "zynq-pluto-sdr";
			data = /incbin/("opensdrlab7010mini.dtb");
			type = "flat_dt";
			arch = "arm";
			compression = "none";
		};

		fpga@1 {
			description = "FPGA";
			data = /incbin/("system_top.bit");
			type = "fpga";
			compatible = "u-boot,fpga-legacy";
			arch = "arm";
			compression = "none";
			load = <0xF000000>;
			hash@1 {
				algo = "md5";
			};
		};

		linux_kernel@1 {
			description = "Linux";
			data = /incbin/("zImage");
			type = "kernel";
			arch = "arm";
			os = "linux";
			compression = "none";
			load = <0x8000>;
			entry = <0x8000>;
			hash@1 {
				algo = "md5";
			};
		};
		ramdisk@1 {
			description = "Ramdisk";
			data = /incbin/("rootfs.cpio.xz");
			type = "ramdisk";
			arch = "arm";
			os = "linux";
			compression = "none";
			hash@1 {
				algo = "md5";
			};
		};

	};

	configurations {
		/*
		 * U-Boot's adi_hwref command (cmd/adi_hwref.c) reads the Zynq XADC
		 * Vp/Vn pins unconditionally at every boot (called from qspiboot)
		 * and sets fit_config to config@<0..9> based on a hardware-revision
		 * voltage divider that real ADI Pluto/M2k boards have wired but
		 * this board doesn't -- the floating pin here reads back as
		 * revision 1. All configs below are identical aliases pointing at
		 * this board's single fdt/fpga/kernel/ramdisk set, so whatever
		 * index adi_hwref computes still resolves. Confirmed necessary on
		 * real hardware 2026-08-23: trimming this down to just config@0
		 * left the board stuck in "Could not find configuration node".
		 */
		default = "config@0";
		config@0 {
			description = "Linux with fpga RevA";
			fdt = "fdt@1";
			kernel = "linux_kernel@1";
			ramdisk = "ramdisk@1";
			fpga = "fpga@1";
		};
		config@1 {
			description = "Linux with fpga RevB";
			fdt = "fdt@1";
			kernel = "linux_kernel@1";
			ramdisk = "ramdisk@1";
			fpga = "fpga@1";
		};
		config@2 {
			description = "Linux with fpga RevB";
			fdt = "fdt@1";
			kernel = "linux_kernel@1";
			ramdisk = "ramdisk@1";
			fpga = "fpga@1";
		};
		config@3 {
			description = "Linux with fpga RevB";
			fdt = "fdt@1";
			kernel = "linux_kernel@1";
			ramdisk = "ramdisk@1";
			fpga = "fpga@1";
		};
		config@4 {
			description = "Linux with fpga RevB";
			fdt = "fdt@1";
			kernel = "linux_kernel@1";
			ramdisk = "ramdisk@1";
			fpga = "fpga@1";
		};
		config@5 {
			description = "Linux with fpga RevB";
			fdt = "fdt@1";
			kernel = "linux_kernel@1";
			ramdisk = "ramdisk@1";
			fpga = "fpga@1";
		};
		config@6 {
			description = "Linux with fpga RevB";
			fdt = "fdt@1";
			kernel = "linux_kernel@1";
			ramdisk = "ramdisk@1";
			fpga = "fpga@1";
		};
		config@7 {
			description = "Linux with fpga RevB";
			fdt = "fdt@1";
			kernel = "linux_kernel@1";
			ramdisk = "ramdisk@1";
			fpga = "fpga@1";
		};
		config@8 {
			description = "Linux with fpga RevC";
			fdt = "fdt@1";
			kernel = "linux_kernel@1";
			ramdisk = "ramdisk@1";
			fpga = "fpga@1";
		};
		config@9 {
			description = "Linux with fpga maiaplus";
			fdt = "fdt@1";
			kernel = "linux_kernel@1";
			ramdisk = "ramdisk@1";
			fpga = "fpga@1";
		};
	};
};
```

## package/board-fpga/Config.in
```kconfig
config BR2_PACKAGE_BOARD_FPGA
	bool "board-fpga"
	help
	  Install pre-built FPGA bitstream for the target board.

config BR2_PACKAGE_BOARD_FPGA_BOARD
	string "Board name for bitstream path"
	depends on BR2_PACKAGE_BOARD_FPGA
	help
	  Name of the board directory under board/tezuka/ containing
	  the bitstream in bitstream/<project>.xsa (see
	  BR2_PACKAGE_BOARD_FPGA_PROJECT for <project>).
	  Examples: pluto, plutoplus, e200, fishball7010, fishball7020

config BR2_PACKAGE_BOARD_FPGA_PROJECT
	string "Bitstream project name"
	default "tezuka"
	depends on BR2_PACKAGE_BOARD_FPGA
	help
	  Name of the maia-hdl project that produced the bitstream, used as
	  the .xsa filename: board/tezuka/<board>/bitstream/<project>.xsa.
	  Most boards use the default "tezuka" project; boards built from a
	  different maia-hdl project (e.g. "ka9q") should set this to match.
```

## package/classifier/Config.in
```kconfig
config BR2_PACKAGE_CLASSIFIER
	bool "classifier"
	select BR2_PACKAGE_LIBWEBSOCKETS
	help
	  Onboard PSD spectral-shape signal classifier — connects to
	  maia-httpd's /waterfall feed as a WebSocket client and
	  correlates live spectrum frames against templates loaded
	  from /mnt/jffs2/classifier/templates.bin, publishing the
	  best match over MQTT.
```

## package/cpdetect/Config.in
```kconfig
config BR2_PACKAGE_CPDETECT
	bool "cpdetect"
	select BR2_PACKAGE_LIBIIO
	help
	  Blind cyclic-prefix (CP-OFDM) detector for the RX stream —
	  reads time-domain IQ through libiio, finds the FFT size, guard
	  length, symbol timing and fractional carrier offset of an OFDM
	  signal without knowing the standard, and prints a JSON line
	  (optionally also publishing to state/cpdetect/ over MQTT).
	  Host-side reference and tests: tools/cpdetect.
```

## package/iio_ws/Config.in
```kconfig
config BR2_PACKAGE_IIO_WS
	bool "iio_ws"
	select BR2_PACKAGE_LIBIIO
	select BR2_PACKAGE_LIBWEBSOCKETS
	help
	  IIO stream to WebSocket Proxy

	  iio_ws_proxy.c links directly against -liio and -lwebsockets
	  (see app/iio_ws/Makefile) but this Config.in never declared
	  either as a real Buildroot dependency. It "worked" only by
	  accident: every board building this so far also happened to
	  pull in BR2_PACKAGE_LIBIIO itself and, separately,
	  BR2_PACKAGE_LIBWEBSOCKETS via tezuka_tools_mini's own select
	  list (a mosquitto-websockets leftover, unrelated to this
	  package -- see that Config.in's comment). Removing that
	  leftover select exposed this: "fatal error: libwebsockets.h:
	  No such file or directory" building fishball_mini{,_7020} in
	  CI run 35263057480. Declaring both selects here, where the
	  real dependency actually lives, fixes it properly instead of
	  restoring the accidental one.
```

## package/libad9361-iio/Config.in
```kconfig
config BR2_PACKAGE_LIBAD9361_IIO
	bool "libad9361-iio"
	depends on BR2_PACKAGE_LIBIIO
	help
	  AD9361 IIO helper library: fast-lock profile management,
	  baseband rate / FIR filter setup, and other convenience
	  calls on top of libiio for the AD9361/AD9364 transceiver
	  used by this board.

	  This symbol previously existed only as an inert reference
	  inherited from ADI's own Buildroot fork (which carries its
	  own package/libad9361-iio); this BR2_EXTERNAL package makes
	  it real against vanilla Buildroot.

	  https://github.com/analogdevicesinc/libad9361-iio
```

## package/longmynd/Config.in
```kconfig
config BR2_PACKAGE_LONGMYND
	bool "longmynd"
	depends on BR2_TOOLCHAIN_HAS_THREADS
	depends on BR2_INSTALL_LIBSTDCPP
	select BR2_PACKAGE_CIVETWEBWS
	select BR2_PACKAGE_CIVETWEBWS_LIB
	select BR2_PACKAGE_LIBUSB
	select BR2_PACKAGE_MOSQUITTO
	select BR2_PACKAGE_ZLIB
	help
	  Longmynd DVB-S/S2 receiver for the MiniTiouner (STV0910 /
	  STV6120 over FTDI), F5OEO fork with MQTT support.

	  https://github.com/F5OEO/longmynd

comment "longmynd needs a toolchain w/ threads, C++"
	depends on !BR2_TOOLCHAIN_HAS_THREADS || !BR2_INSTALL_LIBSTDCPP
```

## package/mqtt_pubd/Config.in
```kconfig
config BR2_PACKAGE_MQTT_PUBD
	bool "mqtt_pubd"
	select BR2_PACKAGE_MOSQUITTO
	help
	  Persistent-connection MQTT publisher daemon used by
	  api_controller.sh to echo device state without spawning a new
	  mosquitto_pub process (and MQTT handshake) per message.
```

## package/sdroxide/Config.in
```kconfig
config BR2_PACKAGE_SDROXIDE
	bool "sdroxide"
	depends on BR2_PACKAGE_HOST_RUSTC_TARGET_ARCH_SUPPORTS
	select BR2_PACKAGE_HOST_RUSTC
	select BR2_PACKAGE_ALSA_LIB
	select BR2_PACKAGE_RUST_WASM
	select BR2_PACKAGE_STUNNEL
	help
	  SDRoxide (https://github.com/dividebysandwich/sdroxide), built
	  headless (native GUI dropped -- see 0001-drop-native-gui-server-only)
	  for `sdroxide --server`: drives this board's own Pluto-compatible
	  IIOD locally and serves TCI/OpenHPSDR/rigctld plus a WebSocket API
	  for a browser client (crates/sdroxide-web, built here too -- see
	  sdroxide.mk). The server binary is large (tens of MB) -- it embeds
	  several neural-net models (CW decode, noise reduction, the
	  FreeDV/RADE vocoder) that ship with upstream regardless of which
	  radio backend is used -- so neither it nor the web client's ~35MB
	  wasm bundle goes into the ramdisk rootfs; both ship on the SD
	  card's FAT boot partition instead (see postimage-sd.sh /
	  S65sdroxide). Only meaningful on an SD-booting board.

	  sdroxide-server has no TLS of its own, and browsers withhold Web
	  Audio (microphone / audio playback) outside a secure context. A
	  stunnel front end (S45sdroxide-tls-cert, stunnel-sdroxide.conf)
	  wraps it in TLS with a throwaway self-signed cert on port 4951,
	  alongside the plain HTTP port 4950.
```

## package/zynqrx/Config.in
```kconfig
config BR2_PACKAGE_ZYNQRX
	bool "zynqrx"
	depends on BR2_TOOLCHAIN_HAS_THREADS
	depends on BR2_INSTALL_LIBSTDCPP
	depends on BR2_ARM_CPU_HAS_NEON
	select BR2_PACKAGE_LIBIIO
	select BR2_PACKAGE_MOSQUITTO
	help
	  DVB-S / DVB-S2 demodulator for the Zynq (2x Cortex-A9 + NEON).

	  Reads IQ from the AD936x through libiio (rx --iio), is controlled
	  and reports status over MQTT in longmynd's scheme (rx --mqtt), and
	  serves the received transport stream as UDP (--udp) and over a
	  WebSocket (--ws, used by the Dashboard's Webtioune page).

	  Built from app/zynqrx in this tree.

comment "zynqrx needs a toolchain w/ threads, C++ and a NEON CPU"
	depends on !BR2_TOOLCHAIN_HAS_THREADS || !BR2_INSTALL_LIBSTDCPP || !BR2_ARM_CPU_HAS_NEON
```
