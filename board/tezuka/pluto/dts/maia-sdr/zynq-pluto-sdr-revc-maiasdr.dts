/*
 * ZYNQ Pluto SDR (Z7010/AD9363) - Maia SDR
 *
 * Copyright (C) 2022-2024 Daniel Estevez <daniel@destevez.net>
 *
 * Licensed under the GPL-2.
*/
/dts-v1/;
#include "zynq-pluto-sdr-revc.dts"
#include "zynq-pluto-sdr-maiasdr.dtsi"

&amba {
        /* Delete PL AXI Quad SPI, which only appears in the Rev. C Device Tree (the AXI
        SPI isn't present in the Maia SDR FPGA design). */
        /delete-node/ spi@7C430000;

        /* Delete axi_tdd, which only appears in the Rev. C Device Tree and the
        IP core isn't present in the Maia SDR FPGA design. */
        /delete-node/ axi-tdd-0@7C440000;
        /delete-node/ iio_axi_tdd_0@0;
};
