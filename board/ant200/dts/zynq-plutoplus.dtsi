/*
 * ZYNQ Pluto SDR (Z7010/AD9363) - PlutoPLus
 *
 * Copyright (C) 2022 Daniel Estevez <daniel@destevez.net>
 * Copyright (C) 2024 F5OEO>
 *
 * Licensed under the GPL-2.
*/

&fpga_axi {
        /delete-node/ i2c@41600000;
        /delete-node/ mwipcore@43c00000;
        
};

