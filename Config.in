## configs/libre_maiasdr_defconfig
```kconfig
BR2_arm=y
BR2_cortex_a9=y
BR2_ARM_ENABLE_NEON=y
BR2_ARM_ENABLE_VFP=y
BR2_TOOLCHAIN_EXTERNAL=y
BR2_TOOLCHAIN_EXTERNAL_ARM_ARM=y
#BR2_TOOLCHAIN_BUILDROOT_WCHAR=y
#BR2_TOOLCHAIN_BUILDROOT_CXX=y
#BR2_TOOLCHAIN_BUILDROOT_FORTRAN=y
BR2_KERNEL_HEADERS_6_1=y
#BR2_DEFAULT_KERNEL_HEADERS="6.1.108"
BR2_OPTIMIZE_3=y
BR2_GLOBAL_PATCH_DIR="${BR2_EXTERNAL_PLUTOSDR_PATH}/board/tezuka/libre/patches"
BR2_TARGET_GENERIC_HOSTNAME="libresdr"
BR2_TARGET_GENERIC_ISSUE="Welcome to Tezuka"
BR2_ROOTFS_DEVICE_CREATION_DYNAMIC_MDEV=y
BR2_TARGET_GENERIC_ROOT_PASSWD="analog"
BR2_TARGET_GENERIC_GETTY_PORT="ttyPS0"
BR2_LINUX_KERNEL=y
BR2_LINUX_KERNEL_CUSTOM_GIT=y
BR2_LINUX_KERNEL_CUSTOM_REPO_URL="https://github.com/analogdevicesinc/linux.git"
#BR2_LINUX_KERNEL_CUSTOM_REPO_VERSION="e14e351533f934047ba0473e836e561682ec67fe"
BR2_LINUX_KERNEL_CUSTOM_REPO_VERSION="04fbdbb433faae8ffb3a5b24b7435509b11334cb"
BR2_LINUX_KERNEL_USE_CUSTOM_CONFIG=y

BR2_LINUX_KERNEL_DTS_SUPPORT=y
BR2_LINUX_KERNEL_USE_CUSTOM_DTS=y

BR2_LINUX_KERNEL_DTB_OVERLAY_SUPPORT=y
BR2_PACKAGE_BUSYBOX_CONFIG="${BR2_EXTERNAL_PLUTOSDR_PATH}/board/tezuka/common/busybox.config"
BR2_PACKAGE_STRACE=y
BR2_PACKAGE_MTD=y
# BR2_PACKAGE_MTD_NANDDUMP is not set
# BR2_PACKAGE_MTD_NANDTEST is not set
# BR2_PACKAGE_MTD_NANDWRITE is not set
# BR2_PACKAGE_MTD_UBIATTACH is not set
# BR2_PACKAGE_MTD_UBICRC32 is not set
# BR2_PACKAGE_MTD_UBIDETACH is not set
# BR2_PACKAGE_MTD_UBIFORMAT is not set
# BR2_PACKAGE_MTD_UBIMKVOL is not set
# BR2_PACKAGE_MTD_UBINFO is not set
# BR2_PACKAGE_MTD_UBINIZE is not set
# BR2_PACKAGE_MTD_UBIRENAME is not set
# BR2_PACKAGE_MTD_UBIRMVOL is not set
# BR2_PACKAGE_MTD_UBIRSVOL is not set
# BR2_PACKAGE_MTD_UBIUPDATEVOL is not set
# BR2_PACKAGE_MTD_UBIBLOCK is not set
BR2_PACKAGE_LINUX_FIRMWARE=y
BR2_PACKAGE_LINUX_FIRMWARE_RALINK_RT61=y
BR2_PACKAGE_LINUX_FIRMWARE_RALINK_RT73=y
BR2_PACKAGE_LINUX_FIRMWARE_RALINK_RT2XX=y
BR2_PACKAGE_LINUX_FIRMWARE_RTL_81XX=y
BR2_PACKAGE_LINUX_FIRMWARE_RTL_87XX=y
BR2_PACKAGE_LINUX_FIRMWARE_RTL_88XX=y
BR2_PACKAGE_INPUT_EVENT_DAEMON=y
BR2_PACKAGE_UBOOT_TOOLS=y
BR2_PACKAGE_ZLIB=y
BR2_PACKAGE_AVAHI=y
BR2_PACKAGE_AVAHI_DAEMON=y
BR2_PACKAGE_AVAHI_LIBDNSSD_COMPATIBILITY=y
BR2_PACKAGE_DROPBEAR=y
BR2_PACKAGE_DROPBEAR_LOCALOPTIONS_FILE="$(BR2_EXTERNAL_PLUTOSDR_PATH)/board/tezuka/common/dropbear_localoptions.h"
BR2_PACKAGE_DROPBEAR_CLIENT=y
BR2_PACKAGE_IW=y
BR2_PACKAGE_WPA_SUPPLICANT=y
BR2_PACKAGE_WPA_SUPPLICANT_CLI=y
BR2_PACKAGE_WPA_SUPPLICANT_PASSPHRASE=y
BR2_TARGET_ROOTFS_CPIO=y
BR2_TARGET_ROOTFS_CPIO_GZIP=y
BR2_TARGET_ROOTFS_CPIO_UIMAGE=y
BR2_TARGET_UBOOT=y
BR2_TARGET_UBOOT_BUILD_SYSTEM_KCONFIG=y
BR2_TARGET_UBOOT_CUSTOM_GIT=y
BR2_TARGET_UBOOT_CUSTOM_REPO_URL="https://github.com/analogdevicesinc/u-boot-xlnx.git"
BR2_TARGET_UBOOT_CUSTOM_REPO_VERSION="90401ce9ce029e5563f4dface63914d42badf5bc"
BR2_TARGET_UBOOT_USE_CUSTOM_CONFIG=y

BR2_TARGET_UBOOT_NEEDS_DTC=y
BR2_TARGET_UBOOT_NEEDS_OPENSSL=y
BR2_TARGET_UBOOT_FORMAT_BIN=y
#BR2_TARGET_UBOOT_ZYNQ_IMAGE=y
BR2_TARGET_UBOOT_FORMAT_IMG=y
BR2_TARGET_UBOOT_FORMAT_ELF=y
BR2_TARGET_UBOOT_FORMAT_BIN_ELF=y

#BR2_TARGET_UBOOT_ZYNQ_IMAGE=y
BR2_TARGET_UBOOT_SPL=y
BR2_TARGET_UBOOT_SPL_NAME="spl/boot.bin"
BR2_PACKAGE_HOST_UBOOT_TOOLS_ENVIMAGE=y

#BR2_TARGET_UBOOT_BUILD_SYSTEM_LEGACY=y

BR2_PACKAGE_UBOOT_TOOLS_MKENVIMAGE=y
BR2_PACKAGE_UBOOT_TOOLS_ENVIMAGE=y
BR2_PACKAGE_HOST_UBOOT_TOOLS_ENVIMAGE_SIZE="0x20000"
#UBOOT_TOOLS_GENERATE_ENV_FILE=y
BR2_PACKAGE_HOST_DFU_UTIL=y
BR2_PACKAGE_HOST_DOSFSTOOLS=y
BR2_PACKAGE_HOST_GENIMAGE=y
BR2_PACKAGE_HOST_BOOTGEN=y
BR2_PACKAGE_HOST_MTOOLS=y
BR2_PACKAGE_HOST_UBOOT_TOOLS_FIT_SUPPORT=y
BR2_PACKAGE_HOST_UBOOT_TOOLS_FIT_SIGNATURE_SUPPORT=y

BR2_PACKAGE_HOST_ENVIRONMENT_SETUP=y

##### BEGIN OF PLUTO NEED #####
CONFIG_UEVENT_HELPER=y
BR2_PACKAGE_LIBIIO=y
BR2_PACKAGE_LIBIIO_IIOD=y
BR2_PACKAGE_LIBIIO_IIOD_USBD=y
BR2_PACKAGE_LIBIIO_LOCAL_BACKEND=y
BR2_PACKAGE_LIBIIO_NETWORK_BACKEND=y
BR2_PACKAGE_LIBGPIOD_TOOLS=y
BR2_PACKAGE_LIBAD9361_IIO=y
BR2_PACKAGE_LIBGPIOD=y
BR2_PACKAGE_AD936X_REF_CAL=y
BR2_PACKAGE_LIBIIO_TESTS=y
BR2_PACKAGE_POLL_SYSFS=y
BR2_PACKAGE_LIBINI=y

####### CUSTOME CONFIGS

##PLUTOPLUS MAIA_IIO
BR2_LINUX_KERNEL_CUSTOM_CONFIG_FILE="$(BR2_EXTERNAL_PLUTOSDR_PATH)/board/tezuka/libre/kernel/zynq_pluto_linux_defconfig"
BR2_TARGET_UBOOT_CUSTOM_CONFIG_FILE="$(BR2_EXTERNAL_PLUTOSDR_PATH)/board/tezuka/libre/u-boot-config/zynq_pluto_defconfig"
BR2_TARGET_UBOOT_CUSTOM_DTS_PATH="$(BR2_EXTERNAL_PLUTOSDR_PATH)/board/tezuka/libre/u-boot-dts/zynq-pluto-sdr.dts $(BR2_EXTERNAL_PLUTOSDR_PATH)/board/tezuka/plutoplus/u-boot-dts/zynq-7000.dtsi"
BR2_PACKAGE_HOST_UBOOT_TOOLS_ENVIMAGE_SOURCE="${BR2_EXTERNAL_PLUTOSDR_PATH}/board/tezuka/plutoplus/uboot-env.txt"
BR2_LINUX_KERNEL_CUSTOM_DTS_PATH="$(BR2_EXTERNAL_PLUTOSDR_PATH)/board/tezuka/libre/dts/zynq-libre.dts $(BR2_EXTERNAL_PLUTOSDR_PATH)/board/tezuka/libre/dts/zynq-libre.dtsi $(BR2_EXTERNAL_PLUTOSDR_PATH)/board/tezuka/libre/dts/zynq-7000.dtsi "
BR2_ROOTFS_OVERLAY="${BR2_EXTERNAL_PLUTOSDR_PATH}/board/tezuka/common/overlay_base ${BR2_EXTERNAL_PLUTOSDR_PATH}/board/tezuka/common/overlay_tezuka ${BR2_EXTERNAL_PLUTOSDR_PATH}/board/tezuka/common/overlay_maia"
BR2_ROOTFS_POST_BUILD_SCRIPT="${BR2_EXTERNAL_PLUTOSDR_PATH}/board/tezuka/common/post-build.sh"
BR2_ROOTFS_POST_IMAGE_SCRIPT="${BR2_EXTERNAL_PLUTOSDR_PATH}/board/tezuka/common/post-image.sh ${BR2_EXTERNAL_PLUTOSDR_PATH}/board/tezuka/libre/post_image-uboot.sh"
BR2_PACKAGE_MAIASDR_FW=y
BR2_PACKAGE_LIBRE_FPGA=y
```

## package/DATV/Config.in
```kconfig
config BR2_PACKAGE_DATV
	bool "DATV Environment"
select BR2_PACKAGE_NFS_UTILS
select BR2_PACKAGE_GPSD
select BR2_PACKAGE_GPSD_PPS
select BR2_PACKAGE_GPSD_UBX
select BR2_PACKAGE_LIBAD9361_IIO
select BR2_PACKAGE_LIBGPIOD
select BR2_PACKAGE_LIBGPIOD_TOOLS
select BR2_PACKAGE_LIBIIO_IIOD_USBD
select BR2_PACKAGE_LIBIIO_TESTS
select BR2_PACKAGE_NE10_ARCH_SUPPORTS
select BR2_PACKAGE_NE10
select BR2_PACKAGE_LIBINI
select BR2_PACKAGE_LIBWEBSOCKETS
select BR2_PACKAGE_FFTW 
select BR2_PACKAGE_FFTW_SINGLE
select BR2_PACKAGE_FFTW_FAST
select BR2_PACKAGE_BC
select BR2_PACKAGE_MOSQUITTO
select BR2_PACKAGE_NTP
select BR2_PACKAGE_NTP_NTPD_ATOM_PPS
select BR2_PACKAGE_NTP_NTPDATE
select BR2_PACKAGE_NTP_NTPDC
select BR2_PACKAGE_NTP_NTPQ
select BR2_PACKAGE_NTP_NTPTIME
select BR2_PACKAGE_NTP_TICKADJ
select BR2_PACKAGE_SOCAT
select BR2_PACKAGE_SSHPASS
select BR2_PACKAGE_OPKG
select BR2_PACKAGE_DIALOG
select BR2_PACKAGE_INOTIFY_TOOLS
select BR2_PACKAGE_HTOP
select BR2_PACKAGE_NANO
select BR2_PACKAGE_POLL_SYSFS
select BR2_PACKAGE_AD936X_REF_CAL
select BR2_PACKAGE_HOST_DTC
	help
	  "DATV Environment"
```

## package/antsdr310_fpga/Config.in
```kconfig
config BR2_PACKAGE_ANTSDR310_FPGA
	bool "antsdr310_fpga"
	help
	  antsdr310_fpga default sytem_top.bit
```

## package/antsdr_fpga/Config.in
```kconfig
config BR2_PACKAGE_ANTSDR_FPGA
	bool "antsdr_fpga"
	help
	  PlutoplusMaia-iio default sytem_top.bit
```

## package/civetwebws/Config.in
```kconfig
config BR2_PACKAGE_CIVETWEBWS
	bool "civetwebws"
	depends on BR2_TOOLCHAIN_HAS_THREADS
	depends on BR2_USE_MMU # fork()
	select BR2_PACKAGE_CIVETWEBWS_SERVER if !BR2_PACKAGE_CIVETWEBWS_LIB
	help
	  Full featured embedded web server with Lua support.

	  https://sourceforge.net/projects/civetweb

if BR2_PACKAGE_CIVETWEBWS

config BR2_PACKAGE_CIVETWEBWS_SERVER
	bool "enable the web server application"
	help
	  Include the web server and its config files.

config BR2_PACKAGE_CIVETWEBWS_LIB
	bool "enable library for embedding"
	help
	  Enable the civetwebws library for embedding in another
	  application.

config BR2_PACKAGE_CIVETWEBWS_WITH_LUA
	bool "enable Lua support"
	# required by the bundled Sqlite3 and Lua code
	depends on !BR2_STATIC_LIBS
	help
	  Enable Lua support in CIVETWEBWS. Note that this will use a
	  version of Lua and Sqlite bundled within the CIVETWEBWS
	  sources, and not the packages from Buildroot.

comment "lua support needs a toolchain w/ dynamic library"
	depends on BR2_STATIC_LIBS

endif

comment "civetwebws needs a toolchain w/ threads"
	depends on BR2_USE_MMU
	depends on !BR2_TOOLCHAIN_HAS_THREADS
```

## package/e200maia-iio-system-top-bit/Config.in
```kconfig
config BR2_PACKAGE_E200_MAIA_IIO_SYSTEM_TOP_BIT
	bool "e200maia-iiosystem-top.bit"
	help
	  Anstdr e200 Maia-iio sytem_top.bit
```

## package/fishball_fpga/Config.in
```kconfig
config BR2_PACKAGE_FISHBALL_FPGA
	bool "fishball_fpga"
	help
	  FishballMaia-iio default sytem_top.bit
```

## package/fishball_fpga_7020/Config.in
```kconfig
config BR2_PACKAGE_FISHBALL_FPGA_7020
	bool "fishball_fpga_7020"
	help
	  FishballMaia-iio_7020 default sytem_top.bit
```

## package/fl2k-kmod/Config.in
```kconfig
config BR2_PACKAGE_FL2K_KMOD
	bool "fl2k module"
    depends on BR2_LINUX_KERNEL
	help
	  FL2K kernel module
```

## package/gr-dvbs2rx/Config.in
```kconfig
config BR2_PACKAGE_GR_DVBS2RX
        bool "gr-dvbs2rx"
        select BR2_PACKAGE_BOOST_TEST
        select BR2_PACKAGE_PYTHON_SCIPY
        depends on BR2_TOOLCHAIN_HAS_THREADS
                 
comment "gnuradio dvbs2rx"
        
```

## package/gr-pdu/Config.in
```kconfig
config BR2_PACKAGE_GR_PDU
        bool "gr-pdu"
        
        
        depends on BR2_TOOLCHAIN_HAS_THREADS
                 
comment "gnuradio gr-pdu"
        
```

## package/gr-satellite/Config.in
```kconfig
config BR2_PACKAGE_GR_SATELLITE
        bool "gr-satellite"
        
        select BR2_PACKAGE_PYTHON_CONSTRUCT
        select BR2_PACKAGE_PYTHON_REQUESTS

        select BR2_PACKAGE_BOOST_PYTHON
 	select BR2_PACKAGE_PYTHON_NUMPY
        select BR2_PACKAGE_PYTHON_WEBSOCKET_CLIENT
        select BR2_PACKAGE_PYTHON_PYAML
        depends on BR2_TOOLCHAIN_HAS_THREADS
                 
comment "gnuradio gr-satellite"
        
```

## package/hamlib/Config.in
```kconfig
config BR2_PACKAGE_HAMLIB
        bool "hamlib"
        help
          Hamlib et rigctl
```

## package/kalibrate/Config.in
```kconfig
config BR2_PACKAGE_KALIBRATE
        bool "kalibrate"
        
        select BR2_PACKAGE_FFTW
             help
          kalibrate calibration tool

          https://github.com/F5OEO/kalibrate-hydrasdr
comment "kalibrate needs a toolchain w/ threads"
        depends on !BR2_TOOLCHAIN_HAS_THREADS
```

## package/libgse/Config.in
```kconfig
config BR2_PACKAGE_LIBGSE
	bool "libgse"
	select BR2_PACKAGE_LIBPCAP
	help
	  LibGSE.

	  https://github.com/CNES/libgse
```

## package/libre_fpga/Config.in
```kconfig
config BR2_PACKAGE_LIBRE_FPGA
	bool "libre_fpga"
	help
	  LibreMaia-iio default sytem_top.bit
```

## package/libssp/Config.in
```kconfig
config BR2_PACKAGE_LIBSSP
	bool "libssp"
	help
	  Libssp.

	  https://www.openmamba.org/pub/openmamba/devel/RPMS.arm/libssp-8.2.0-1mamba.arm.rpm
```

## package/maia-httpd/Config.in
```kconfig
config BR2_PACKAGE_MAIA_HTTPD
	bool "maia_httpd"
	depends on BR2_PACKAGE_HOST_RUSTC_TARGET_ARCH_SUPPORTS
	select BR2_PACKAGE_HOST_RUSTC
	help
	  MaiaSDR httpd server
```

## package/maia-kmod/Config.in
```kconfig
config BR2_PACKAGE_MAIA_KMOD
	bool "maia_kmod module"
    depends on BR2_LINUX_KERNEL
	help
	  MaiaSDR kernel module
```

## package/maia-wasm/Config.in
```kconfig
config BR2_PACKAGE_MAIA_WASM
	bool "maia_wasm"
	select BR2_PACKAGE_WASM_PACK
	depends on BR2_PACKAGE_HOST_RUSTC_TARGET_ARCH_SUPPORTS
	select BR2_PACKAGE_HOST_RUSTC
	help
	  MaiaSDR Wasm
```
