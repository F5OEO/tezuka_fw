## configs/e200_maiasdr_defconfig
```kconfig
BR2_arm=y
BR2_cortex_a9=y
BR2_ARM_ENABLE_NEON=y
BR2_ARM_ENABLE_VFP=y
BR2_TOOLCHAIN_EXTERNAL=y
BR2_TOOLCHAIN_EXTERNAL_ARM_ARM=y
#BR2_TOOLCHAIN_BUILDROOT_WCHAR=y
#BR2_TOOLCHAIN_BUILDROOT_CXX=y
#BR2_TOOLCHAIN_BUILDROOT_FORTRAN=y
BR2_KERNEL_HEADERS_6_1=y
#BR2_DEFAULT_KERNEL_HEADERS="6.1.108"
BR2_OPTIMIZE_3=y
BR2_GLOBAL_PATCH_DIR="${BR2_EXTERNAL_PLUTOSDR_PATH}/board/pluto/patches"
BR2_TARGET_GENERIC_HOSTNAME="antsdre200"
BR2_TARGET_GENERIC_ISSUE="Welcome to Tezuka"
BR2_ROOTFS_DEVICE_CREATION_DYNAMIC_MDEV=y
BR2_TARGET_GENERIC_ROOT_PASSWD="analog"
BR2_TARGET_GENERIC_GETTY_PORT="ttyPS0"
BR2_LINUX_KERNEL=y
BR2_LINUX_KERNEL_CUSTOM_GIT=y
BR2_LINUX_KERNEL_CUSTOM_REPO_URL="https://github.com/analogdevicesinc/linux.git"
#BR2_LINUX_KERNEL_CUSTOM_REPO_VERSION="e14e351533f934047ba0473e836e561682ec67fe"
BR2_LINUX_KERNEL_CUSTOM_REPO_VERSION="04fbdbb433faae8ffb3a5b24b7435509b11334cb"
#BR2_LINUX_KERNEL_DEFCONFIG="zynq_pluto"
BR2_LINUX_KERNEL_USE_CUSTOM_CONFIG=y

#BR2_LINUX_KERNEL_CONFIG_FRAGMENT_FILES="$(BR2_EXTERNAL_PLUTOSDR_PATH)/board/pluto/linux-$(BR2_LINUX_KERNEL_VERSION).fragment"
BR2_LINUX_KERNEL_DTS_SUPPORT=y
BR2_LINUX_KERNEL_USE_CUSTOM_DTS=y

BR2_LINUX_KERNEL_DTB_OVERLAY_SUPPORT=y
BR2_PACKAGE_BUSYBOX_CONFIG="${BR2_EXTERNAL_PLUTOSDR_PATH}/board/pluto/busybox.config"
BR2_PACKAGE_STRACE=y
BR2_PACKAGE_MTD=y
# BR2_PACKAGE_MTD_NANDDUMP is not set
# BR2_PACKAGE_MTD_NANDTEST is not set
# BR2_PACKAGE_MTD_NANDWRITE is not set
# BR2_PACKAGE_MTD_UBIATTACH is not set
# BR2_PACKAGE_MTD_UBICRC32 is not set
# BR2_PACKAGE_MTD_UBIDETACH is not set
# BR2_PACKAGE_MTD_UBIFORMAT is not set
# BR2_PACKAGE_MTD_UBIMKVOL is not set
# BR2_PACKAGE_MTD_UBINFO is not set
# BR2_PACKAGE_MTD_UBINIZE is not set
# BR2_PACKAGE_MTD_UBIRENAME is not set
# BR2_PACKAGE_MTD_UBIRMVOL is not set
# BR2_PACKAGE_MTD_UBIRSVOL is not set
# BR2_PACKAGE_MTD_UBIUPDATEVOL is not set
# BR2_PACKAGE_MTD_UBIBLOCK is not set
BR2_PACKAGE_LINUX_FIRMWARE=y
BR2_PACKAGE_LINUX_FIRMWARE_RALINK_RT61=y
BR2_PACKAGE_LINUX_FIRMWARE_RALINK_RT73=y
BR2_PACKAGE_LINUX_FIRMWARE_RALINK_RT2XX=y
BR2_PACKAGE_LINUX_FIRMWARE_RTL_81XX=y
BR2_PACKAGE_LINUX_FIRMWARE_RTL_87XX=y
BR2_PACKAGE_LINUX_FIRMWARE_RTL_88XX=y
BR2_PACKAGE_INPUT_EVENT_DAEMON=y
BR2_PACKAGE_UBOOT_TOOLS=y
BR2_PACKAGE_ZLIB=y
BR2_PACKAGE_AVAHI=y
BR2_PACKAGE_AVAHI_DAEMON=y
BR2_PACKAGE_AVAHI_LIBDNSSD_COMPATIBILITY=y
BR2_PACKAGE_DROPBEAR=y
BR2_PACKAGE_DROPBEAR_LOCALOPTIONS_FILE="$(BR2_EXTERNAL_PLUTOSDR_PATH)/board/pluto/dropbear_localoptions.h"
BR2_PACKAGE_DROPBEAR_CLIENT=y
BR2_PACKAGE_IW=y
BR2_PACKAGE_WPA_SUPPLICANT=y
BR2_PACKAGE_WPA_SUPPLICANT_CLI=y
BR2_PACKAGE_WPA_SUPPLICANT_PASSPHRASE=y
BR2_TARGET_ROOTFS_CPIO=y
BR2_TARGET_ROOTFS_CPIO_GZIP=y
BR2_TARGET_ROOTFS_CPIO_UIMAGE=y
BR2_TARGET_UBOOT=y
BR2_TARGET_UBOOT_BUILD_SYSTEM_KCONFIG=y
BR2_TARGET_UBOOT_CUSTOM_GIT=y
BR2_TARGET_UBOOT_CUSTOM_REPO_URL="https://github.com/analogdevicesinc/u-boot-xlnx.git"
BR2_TARGET_UBOOT_CUSTOM_REPO_VERSION="90401ce9ce029e5563f4dface63914d42badf5bc"
#BR2_TARGET_UBOOT_BOARD_DEFCONFIG="zynq_pluto"
BR2_TARGET_UBOOT_USE_CUSTOM_CONFIG=y

BR2_TARGET_UBOOT_NEEDS_DTC=y
BR2_TARGET_UBOOT_NEEDS_OPENSSL=y
BR2_TARGET_UBOOT_FORMAT_BIN=y
#BR2_TARGET_UBOOT_ZYNQ_IMAGE=y
BR2_TARGET_UBOOT_FORMAT_IMG=y
BR2_TARGET_UBOOT_FORMAT_ELF=y
BR2_TARGET_UBOOT_FORMAT_BIN_ELF=y

#BR2_TARGET_UBOOT_ZYNQ_IMAGE=y
BR2_TARGET_UBOOT_SPL=y
BR2_TARGET_UBOOT_SPL_NAME="spl/boot.bin"
BR2_PACKAGE_HOST_UBOOT_TOOLS_ENVIMAGE=y

#BR2_TARGET_UBOOT_BUILD_SYSTEM_LEGACY=y

BR2_PACKAGE_UBOOT_TOOLS_MKENVIMAGE=y
BR2_PACKAGE_UBOOT_TOOLS_ENVIMAGE=y
BR2_PACKAGE_HOST_UBOOT_TOOLS_ENVIMAGE_SIZE="0x20000"
#UBOOT_TOOLS_GENERATE_ENV_FILE=y
BR2_PACKAGE_HOST_DFU_UTIL=y
BR2_PACKAGE_HOST_DOSFSTOOLS=y
BR2_PACKAGE_HOST_GENIMAGE=y
BR2_PACKAGE_HOST_MTOOLS=y
BR2_PACKAGE_HOST_BOOTGEN=y
BR2_PACKAGE_HOST_UBOOT_TOOLS_FIT_SUPPORT=y
BR2_PACKAGE_HOST_UBOOT_TOOLS_FIT_SIGNATURE_SUPPORT=y

BR2_PACKAGE_HOST_ENVIRONMENT_SETUP=y

##### BEGIN OF PLUTO NEED #####
CONFIG_UEVENT_HELPER=y
BR2_PACKAGE_LIBIIO=y
BR2_PACKAGE_LIBIIO_IIOD=y
BR2_PACKAGE_LIBIIO_IIOD_USBD=y
BR2_PACKAGE_LIBIIO_LOCAL_BACKEND=y
BR2_PACKAGE_LIBIIO_NETWORK_BACKEND=y
BR2_PACKAGE_LIBGPIOD_TOOLS=y
BR2_PACKAGE_LIBAD9361_IIO=y
BR2_PACKAGE_LIBGPIOD=y
BR2_PACKAGE_AD936X_REF_CAL=y
BR2_PACKAGE_LIBIIO_TESTS=y
BR2_PACKAGE_POLL_SYSFS=y
BR2_PACKAGE_LIBINI=y

####### CUSTOME CONFIGS

## MAIA_SDR
#BR2_LINUX_KERNEL_CUSTOM_CONFIG_FILE="$(BR2_EXTERNAL_PLUTOSDR_PATH)/board/pluto/kernel/zynq_pluto_linux_defconfig"
#BR2_TARGET_UBOOT_CUSTOM_CONFIG_FILE="$(BR2_EXTERNAL_PLUTOSDR_PATH)/board/pluto/u-boot-config/zynq_pluto_defconfig"
#BR2_TARGET_UBOOT_CUSTOM_DTS_PATH="$(BR2_EXTERNAL_PLUTOSDR_PATH)/board/pluto/u-boot-dts/zynq-pluto-sdr.dts $(BR2_EXTERNAL_PLUTOSDR_PATH)/board/pluto/u-boot-dts/zynq-7000.dtsi"
#BR2_PACKAGE_HOST_UBOOT_TOOLS_ENVIMAGE_SOURCE="${BR2_EXTERNAL_PLUTOSDR_PATH}/board/pluto/uboot-env.txt"
#BR2_LINUX_KERNEL_CUSTOM_DTS_PATH="$(BR2_EXTERNAL_PLUTOSDR_PATH)/board/pluto/dts/zynq-pluto-sdr.dts $(BR2_EXTERNAL_PLUTOSDR_PATH)/board/pluto/dts/zynq-pluto-sdr-revb.dts $(BR2_EXTERNAL_PLUTOSDR_PATH)/board/pluto/dts/zynq-pluto-sdr-revc.dts $(BR2_EXTERNAL_PLUTOSDR_PATH)/board/pluto/dts/zynq-pluto-sdr.dtsi $(BR2_EXTERNAL_PLUTOSDR_PATH)/board/pluto/dts/maia-sdr/zynq-pluto-sdr-maiasdr.dts $(BR2_EXTERNAL_PLUTOSDR_PATH)/board/pluto/dts/maia-sdr/zynq-pluto-sdr-revb-maiasdr.dts $(BR2_EXTERNAL_PLUTOSDR_PATH)/board/pluto/dts/maia-sdr/zynq-pluto-sdr-revc-maiasdr.dts $(BR2_EXTERNAL_PLUTOSDR_PATH)/board/pluto/dts/maia-sdr/zynq-pluto-sdr-maiasdr.dtsi "
#BR2_ROOTFS_OVERLAY="${BR2_EXTERNAL_PLUTOSDR_PATH}/board/pluto/overlay_maia"
#BR2_ROOTFS_POST_BUILD_SCRIPT="${BR2_EXTERNAL_PLUTOSDR_PATH}/board/pluto/post-build.sh"
#BR2_ROOTFS_POST_IMAGE_SCRIPT="${BR2_EXTERNAL_PLUTOSDR_PATH}/board/pluto/post_image_maia.sh ${BR2_EXTERNAL_PLUTOSDR_PATH}/board/pluto/post_image-uboot.sh"
#BR2_PACKAGE_MAIASDR_FW=y

## MAIA_IIO
#BR2_LINUX_KERNEL_CUSTOM_CONFIG_FILE="$(BR2_EXTERNAL_PLUTOSDR_PATH)/board/pluto/kernel/zynq_pluto_linux_defconfig"
#BR2_TARGET_UBOOT_CUSTOM_CONFIG_FILE="$(BR2_EXTERNAL_PLUTOSDR_PATH)/board/pluto/u-boot-config/zynq_pluto_defconfig"
#BR2_TARGET_UBOOT_CUSTOM_DTS_PATH="$(BR2_EXTERNAL_PLUTOSDR_PATH)/board/pluto/u-boot-dts/zynq-pluto-sdr.dts $(BR2_EXTERNAL_PLUTOSDR_PATH)/board/pluto/u-boot-dts/zynq-7000.dtsi"
#BR2_PACKAGE_HOST_UBOOT_TOOLS_ENVIMAGE_SOURCE="${BR2_EXTERNAL_PLUTOSDR_PATH}/board/pluto/uboot-env.txt"
#BR2_LINUX_KERNEL_CUSTOM_DTS_PATH="$(BR2_EXTERNAL_PLUTOSDR_PATH)/board/pluto/dts/zynq-pluto-sdr.dts $(BR2_EXTERNAL_PLUTOSDR_PATH)/board/pluto/dts/zynq-pluto-sdr-revb.dts $(BR2_EXTERNAL_PLUTOSDR_PATH)/board/pluto/dts/zynq-pluto-sdr-revc.dts $(BR2_EXTERNAL_PLUTOSDR_PATH)/board/pluto/dts/zynq-pluto-sdr.dtsi $(BR2_EXTERNAL_PLUTOSDR_PATH)/board/pluto/dts/maia-iio/zynq-pluto-sdr-maiasdr.dts $(BR2_EXTERNAL_PLUTOSDR_PATH)/board/pluto/dts/maia-iio/zynq-pluto-sdr-revb-maiasdr.dts $(BR2_EXTERNAL_PLUTOSDR_PATH)/board/pluto/dts/maia-iio/zynq-pluto-sdr-revc-maiasdr.dts $(BR2_EXTERNAL_PLUTOSDR_PATH)/board/pluto/dts/maia-iio/zynq-pluto-sdr-maiasdr.dtsi "
#BR2_ROOTFS_OVERLAY="${BR2_EXTERNAL_PLUTOSDR_PATH}/board/pluto/overlay_maia"
#BR2_ROOTFS_POST_BUILD_SCRIPT="${BR2_EXTERNAL_PLUTOSDR_PATH}/board/pluto/post-build.sh"
#BR2_ROOTFS_POST_IMAGE_SCRIPT="${BR2_EXTERNAL_PLUTOSDR_PATH}/board/pluto/post_image_maia.sh ${BR2_EXTERNAL_PLUTOSDR_PATH}/board/pluto/post_image-uboot.sh"
#BR2_PACKAGE_MAIASDR_FW=y

##PLUTOSDR ORIGINAL
#BR2_LINUX_KERNEL_CUSTOM_CONFIG_FILE="$(BR2_EXTERNAL_PLUTOSDR_PATH)/board/pluto/kernel/zynq_pluto_linux_defconfig"
#BR2_TARGET_UBOOT_CUSTOM_CONFIG_FILE="$(BR2_EXTERNAL_PLUTOSDR_PATH)/board/pluto/u-boot-config/zynq_pluto_defconfig"
#BR2_TARGET_UBOOT_CUSTOM_DTS_PATH="$(BR2_EXTERNAL_PLUTOSDR_PATH)/board/pluto/u-boot-dts/zynq-pluto-sdr.dts $(BR2_EXTERNAL_PLUTOSDR_PATH)/board/pluto/u-boot-dts/zynq-7000.dtsi"
#BR2_PACKAGE_HOST_UBOOT_TOOLS_ENVIMAGE_SOURCE="${BR2_EXTERNAL_PLUTOSDR_PATH}/board/pluto/uboot-env.txt"
#BR2_LINUX_KERNEL_CUSTOM_DTS_PATH="$(BR2_EXTERNAL_PLUTOSDR_PATH)/board/pluto/dts/zynq-pluto-sdr.dts $(BR2_EXTERNAL_PLUTOSDR_PATH)/board/pluto/dts/zynq-pluto-sdr-revb.dts $(BR2_EXTERNAL_PLUTOSDR_PATH)/board/pluto/dts/zynq-pluto-sdr-revc.dts $(BR2_EXTERNAL_PLUTOSDR_PATH)/board/pluto/dts/zynq-pluto-sdr.dtsi"
#BR2_ROOTFS_OVERLAY="${BR2_EXTERNAL_PLUTOSDR_PATH}/board/pluto/overlay"
#BR2_ROOTFS_POST_BUILD_SCRIPT="${BR2_EXTERNAL_PLUTOSDR_PATH}/board/pluto/post-build.sh"
#BR2_ROOTFS_POST_IMAGE_SCRIPT="${BR2_EXTERNAL_PLUTOSDR_PATH}/board/pluto/post_image.sh ${BR2_EXTERNAL_PLUTOSDR_PATH}/board/pluto/post_image-uboot.sh"
#BR2_PACKAGE_TEZUKA_COMMON_TOOLS=y

##PLUTOPLUS ORIGINAL
#BR2_LINUX_KERNEL_CUSTOM_CONFIG_FILE="$(BR2_EXTERNAL_PLUTOSDR_PATH)/board/plutoplus/kernel/zynq_pluto_linux_defconfig"
#BR2_TARGET_UBOOT_CUSTOM_CONFIG_FILE="$(BR2_EXTERNAL_PLUTOSDR_PATH)/board/plutoplus/u-boot-config/zynq_pluto_defconfig"
#BR2_TARGET_UBOOT_CUSTOM_DTS_PATH="$(BR2_EXTERNAL_PLUTOSDR_PATH)/board/plutoplus/u-boot-dts/zynq-pluto-sdr.dts $(BR2_EXTERNAL_PLUTOSDR_PATH)/board/plutoplus/u-boot-dts/zynq-7000.dtsi"
#BR2_PACKAGE_HOST_UBOOT_TOOLS_ENVIMAGE_SOURCE="${BR2_EXTERNAL_PLUTOSDR_PATH}/board/plutoplus/uboot-env.txt"
#BR2_LINUX_KERNEL_CUSTOM_DTS_PATH="$(BR2_EXTERNAL_PLUTOSDR_PATH)/board/plutoplus/dts/zynq-pluto-sdr.dts $(BR2_EXTERNAL_PLUTOSDR_PATH)/board/plutoplus/dts/zynq-pluto-sdr-revb.dts $(BR2_EXTERNAL_PLUTOSDR_PATH)/board/plutoplus/dts/zynq-pluto-sdr-revc.dts $(BR2_EXTERNAL_PLUTOSDR_PATH)/board/plutoplus/dts/zynq-pluto-sdr.dtsi $(BR2_EXTERNAL_PLUTOSDR_PATH)/board/plutoplus/dts/zynq-plutoplus.dtsi $(BR2_EXTERNAL_PLUTOSDR_PATH)/board/plutoplus/dts/zynq-plutoplus.dts"
#BR2_ROOTFS_OVERLAY="${BR2_EXTERNAL_PLUTOSDR_PATH}/board/pluto/overlay"
#BR2_ROOTFS_POST_BUILD_SCRIPT="${BR2_EXTERNAL_PLUTOSDR_PATH}/board/pluto/post-build.sh"
#BR2_ROOTFS_POST_IMAGE_SCRIPT="${BR2_EXTERNAL_PLUTOSDR_PATH}/board/plutoplus/post_image.sh ${BR2_EXTERNAL_PLUTOSDR_PATH}/board/plutoplus/post_image-uboot.sh"
#BR2_PACKAGE_TEZUKA_COMMON_TOOLS=y
#BR2_PACKAGE_PLUTOPLUS_SYSTEM_TOP_BIT=y

##PLUTOPLUS MAIA_IIO
BR2_LINUX_KERNEL_CUSTOM_CONFIG_FILE="$(BR2_EXTERNAL_PLUTOSDR_PATH)/board/e200/kernel/zynq_pluto_linux_defconfig"
BR2_TARGET_UBOOT_CUSTOM_CONFIG_FILE="$(BR2_EXTERNAL_PLUTOSDR_PATH)/board/e200/u-boot-config/zynq_pluto_defconfig"
BR2_TARGET_UBOOT_CUSTOM_DTS_PATH="$(BR2_EXTERNAL_PLUTOSDR_PATH)/board/e200/u-boot-dts/zynq-pluto-sdr.dts $(BR2_EXTERNAL_PLUTOSDR_PATH)/board/plutoplus/u-boot-dts/zynq-7000.dtsi"
BR2_PACKAGE_HOST_UBOOT_TOOLS_ENVIMAGE_SOURCE="${BR2_EXTERNAL_PLUTOSDR_PATH}/board/plutoplus/uboot-env.txt"
BR2_LINUX_KERNEL_CUSTOM_DTS_PATH="$(BR2_EXTERNAL_PLUTOSDR_PATH)/board/e200/dts/zynq-e200.dts $(BR2_EXTERNAL_PLUTOSDR_PATH)/board/e200/dts/zynq-e200.dtsi $(BR2_EXTERNAL_PLUTOSDR_PATH)/board/e200/dts/zynq-7000.dtsi "
BR2_ROOTFS_OVERLAY="${BR2_EXTERNAL_PLUTOSDR_PATH}/board/pluto/overlay_maia"
BR2_ROOTFS_POST_BUILD_SCRIPT="${BR2_EXTERNAL_PLUTOSDR_PATH}/board/pluto/post-build.sh"
BR2_ROOTFS_POST_IMAGE_SCRIPT="${BR2_EXTERNAL_PLUTOSDR_PATH}/board/e200/post_image_maia.sh ${BR2_EXTERNAL_PLUTOSDR_PATH}/board/e200/post_image-uboot.sh"
BR2_PACKAGE_MAIASDR_FW=y
BR2_PACKAGE_ANTSDR_FPGA=y
```
