## Config.in
```kconfig
source "$BR2_EXTERNAL_PLUTOSDR_PATH/package/pluto-system-top-bit/Config.in"
source "$BR2_EXTERNAL_PLUTOSDR_PATH/package/plutoplus-system-top-bit/Config.in"
source "$BR2_EXTERNAL_PLUTOSDR_PATH/package/DATV/Config.in"
source "$BR2_EXTERNAL_PLUTOSDR_PATH/package/sdonly/Config.in"
source "$BR2_EXTERNAL_PLUTOSDR_PATH/package/maia-kmod/Config.in"
source "$BR2_EXTERNAL_PLUTOSDR_PATH/package/maia-httpd/Config.in"
source "$BR2_EXTERNAL_PLUTOSDR_PATH/package/pluto-fpga/Config.in"
source "$BR2_EXTERNAL_PLUTOSDR_PATH/package/tezuka_tools/Config.in"
source "$BR2_EXTERNAL_PLUTOSDR_PATH/package/sdr_usb_gadget/Config.in"
source "$BR2_EXTERNAL_PLUTOSDR_PATH/package/futuresdr/Config.in"
source "$BR2_EXTERNAL_PLUTOSDR_PATH/package/plutomaia-system-top-bit/Config.in"
source "$BR2_EXTERNAL_PLUTOSDR_PATH/package/wasm-pack/Config.in"
source "$BR2_EXTERNAL_PLUTOSDR_PATH/package/rust-wasm/Config.in"
source "$BR2_EXTERNAL_PLUTOSDR_PATH/package/maia-wasm/Config.in"
source "$BR2_EXTERNAL_PLUTOSDR_PATH/package/maiasdr-fw/Config.in"
source "$BR2_EXTERNAL_PLUTOSDR_PATH/package/plutomaia-iio-system-top-bit/Config.in"
source "$BR2_EXTERNAL_PLUTOSDR_PATH/package/plutoplusmaia-iio-system-top-bit/Config.in"
source "$BR2_EXTERNAL_PLUTOSDR_PATH/package/antsdr_fpga/Config.in"
source "$BR2_EXTERNAL_PLUTOSDR_PATH/package/signalsdrpro_fpga/Config.in"
source "$BR2_EXTERNAL_PLUTOSDR_PATH/package/civetwebws/Config.in"
source "$BR2_EXTERNAL_PLUTOSDR_PATH/package/libre_fpga/Config.in"
source "$BR2_EXTERNAL_PLUTOSDR_PATH/package/srt/Config.in"
source "$BR2_EXTERNAL_PLUTOSDR_PATH/package/fishball_fpga/Config.in"
source "$BR2_EXTERNAL_PLUTOSDR_PATH/package/fishball_fpga_7020/Config.in"
```

## board/libre/u-boot-config/zynq_pluto_defconfig
```kconfig
CONFIG_ARM=y
CONFIG_SYS_CONFIG_NAME="zynq_pluto-sdr"
CONFIG_ARCH_ZYNQ=y
CONFIG_SYS_MALLOC_F_LEN=0x800
CONFIG_DEFAULT_DEVICE_TREE="zynq-pluto-sdr"
CONFIG_SPL=y
CONFIG_FIT=y
CONFIG_FIT_VERBOSE=y
CONFIG_FIT_SIGNATURE=y
CONFIG_BOOTDELAY=3
CONFIG_SYS_NO_FLASH=y
CONFIG_HUSH_PARSER=y
CONFIG_SYS_PROMPT="LIBRESDR> "
# CONFIG_CMD_IMLS is not set
# CONFIG_CMD_XIMG is not set
# CONFIG_CMD_FLASH is not set
CONFIG_CMD_SF=y
CONFIG_CMD_SPI=y
CONFIG_CMD_USB=y
CONFIG_CMD_DFU=y
CONFIG_DM_GPIO=y
CONFIG_ZYNQ_GPIO=y
CONFIG_CMD_GPIO=y
# CONFIG_CMD_SETEXPR is not set
# CONFIG_CMD_NET is not set
# CONFIG_CMD_NFS is not set
CONFIG_CMD_CACHE=y
CONFIG_CMD_EXT2=y
CONFIG_CMD_EXT4=y
CONFIG_CMD_EXT4_WRITE=y
CONFIG_CMD_FAT=y
CONFIG_CMD_FS_GENERIC=y
CONFIG_OF_EMBED=y
CONFIG_SPL_DM_SEQ_ALIAS=y
CONFIG_LED=y
CONFIG_LED_GPIO=y
CONFIG_SPI_FLASH=y
CONFIG_SPI_FLASH_BAR=y
CONFIG_SPI_FLASH_ISSI=y
CONFIG_SPI_FLASH_MACRONIX=y
CONFIG_SPI_FLASH_SPANSION=y
CONFIG_SPI_FLASH_STMICRO=y
CONFIG_SPI_FLASH_WINBOND=y
CONFIG_ZYNQ_QSPI=y
CONFIG_USB=y
CONFIG_USB_EHCI_HCD=y
CONFIG_USB_ULPI_VIEWPORT=y
CONFIG_USB_ULPI=y
CONFIG_USB_STORAGE=y
CONFIG_USB_GADGET=y
CONFIG_CI_UDC=y
CONFIG_USB_GADGET_VBUS_DRAW=500
CONFIG_USB_GADGET_DOWNLOAD=y
CONFIG_G_DNL_MANUFACTURER="Analog Devices Inc."
CONFIG_G_DNL_VENDOR_NUM=0x0456
CONFIG_G_DNL_PRODUCT_NUM=0xb674
CONFIG_REGEX=y
CONFIG_LIB_RAND=y
CONFIG_ZYNQ_SDHCI=y
CONFIG_CMD_MMC=y
CONFIG_MMC_SDHCI=y
CONFIG_MMC_SDHCI_ZYNQ=y
CONFIG_SD_BOOT=y
```

## board/tezuka/plutoplus/u-boot-config/zynq_pluto_defconfig
```kconfig
CONFIG_ARM=y
CONFIG_SYS_CONFIG_NAME="zynq_pluto-sdr"
CONFIG_ARCH_ZYNQ=y
CONFIG_SYS_TIMER_COUNTS_DOWN=y
CONFIG_ZYNQ_SERIAL=y
CONFIG_SYS_LOAD_ADDR=0x0
CONFIG_TEXT_BASE=0x4000000
CONFIG_SPL_BSS_START_ADDR=0x100000
CONFIG_SPL_BSS_MAX_SIZE=0x100000
CONFIG_SPL_STACK_R_ADDR=0x200000
CONFIG_SPL_STACK=0xfffffe00
CONFIG_SPL_MAX_SIZE=0x30000
# CONFIG_SPL_SHARES_INIT_SP_ADDR is not set
CONFIG_SPL_SYS_MALLOC=y
CONFIG_SPL_SYS_MALLOC_SIZE=0x2000000
CONFIG_SPL_STACK_R=y
CONFIG_SYS_BOOTM_LEN=0x3C00000
CONFIG_SYS_MAXARGS=32
CONFIG_SYS_CBSIZE=2048
CONFIG_SYS_PBSIZE=2071
CONFIG_LEGACY_IMAGE_FORMAT=y
CONFIG_USE_PREBOOT=y
CONFIG_SYS_CUSTOM_LDSCRIPT=y
CONFIG_SYS_LDSCRIPT="arch/arm/mach-zynq/u-boot.lds"
# CONFIG_SPL_FPGA is not set
CONFIG_SPL_OS_BOOT=y
CONFIG_SPL_PAYLOAD_ARGS_ADDR=0x10000000
CONFIG_SYS_DFU_DATA_BUF_SIZE=0x600000
CONFIG_SYS_MALLOC_LEN=0x1400000
CONFIG_ENV_SIZE=0x20000
CONFIG_ENV_OFFSET=0x100000
CONFIG_SYS_SPI_U_BOOT_OFFS=0x100000
CONFIG_BOOTCOMMAND="run $modeboot"
CONFIG_SYS_MALLOC_F_LEN=0x800
CONFIG_DEFAULT_DEVICE_TREE="zynq-pluto-sdr"
CONFIG_SPL=y
CONFIG_FIT=y
CONFIG_FIT_VERBOSE=y
CONFIG_FIT_SIGNATURE=y
CONFIG_BOOTDELAY=3
CONFIG_SYS_NO_FLASH=y
CONFIG_HUSH_PARSER=y
CONFIG_SYS_PROMPT="Pluto+> "
# CONFIG_CMD_IMLS is not set
# CONFIG_CMD_XIMG is not set
# CONFIG_CMD_FLASH is not set
CONFIG_CMD_SF=y
CONFIG_CMD_SPI=y
CONFIG_CMD_USB=y
CONFIG_CMD_DFU=y
CONFIG_DFU_SF=y
CONFIG_DFU_RAM=y
CONFIG_DFU_MMC=y
CONFIG_CMD_GPIO=y
CONFIG_DM_GPIO=y
CONFIG_ZYNQ_GPIO=y
# CONFIG_CMD_SETEXPR is not set
# CONFIG_CMD_NET is not set
# CONFIG_CMD_NFS is not set
CONFIG_CMD_CACHE=y
CONFIG_CMD_EXT2=y
CONFIG_CMD_EXT4=y
CONFIG_CMD_EXT4_WRITE=y
CONFIG_CMD_FAT=y
CONFIG_CMD_FS_GENERIC=y
CONFIG_OF_EMBED=y
CONFIG_SPL_DM_SEQ_ALIAS=y
CONFIG_LED=y
CONFIG_LED_GPIO=y
CONFIG_SPI_FLASH=y
CONFIG_SPI_FLASH_BAR=y
CONFIG_SPI_FLASH_ISSI=y
CONFIG_SPI_FLASH_MACRONIX=y
CONFIG_SPI_FLASH_SPANSION=y
CONFIG_SPI_FLASH_STMICRO=y
CONFIG_SPI_FLASH_WINBOND=y
CONFIG_ZYNQ_QSPI=y
CONFIG_USB=y
CONFIG_USB_EHCI_HCD=y
CONFIG_USB_ULPI_VIEWPORT=y
CONFIG_USB_ULPI=y
CONFIG_USB_STORAGE=y
CONFIG_USB_GADGET=y
CONFIG_CI_UDC=y
CONFIG_USB_GADGET_VBUS_DRAW=500
CONFIG_USB_GADGET_DOWNLOAD=y
CONFIG_G_DNL_MANUFACTURER="Analog Devices Inc."
CONFIG_G_DNL_VENDOR_NUM=0x0456
CONFIG_G_DNL_PRODUCT_NUM=0xb674
CONFIG_REGEX=y
CONFIG_LIB_RAND=y
## EXTENSION ##
CONFIG_NET_RANDOM_ETHADDR=y
CONFIG_DM_MMC=y
CONFIG_ZYNQ_SDHCI=y
CONFIG_NAND_ARASAN=y
CONFIG_CMD_MMC=y
#CONFIG_MMC_SDHCI=y
#CONFIG_MMC_SDHCI_ZYNQ=y
CONFIG_SD_BOOT=y
CONFIG_DM_ETH=y
CONFIG_ZYNQ_GEM=y
CONFIG_CMD_NET=y
CONFIG_NET=y
CONFIG_ZYNQ_GEM=y
CONFIG_CMD_DHCP=y
CONFIG_CMD_PING=y
CONFIG_CMD_NFS=y
ONFIG_DOS_PARTITION=y
CONFIG_SUPPORT_VFAT=y
CONFIG_FAT_WRITE=y
```
